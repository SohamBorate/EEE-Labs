PWM BIT P3.4
ADC_DAT_PORT EQU P0
ADC_DAT EQU 30H

ORG 0000H
LJMP MAIN

MAIN:

// INIT ADC

LJMP LOOP

//////////
// load timer and set output level
//////////

LOOP: ACALL SAMPLEADC
SETB PWM
ACALL DELAY_START
ACALL DELAY_DUTY_HIGH
CLR PWM
ACALL DELAY_DUTY_LOW
ACALL DELAY_END
SJMP LOOP

SAMPLEADC: MOV ADC_DAT, ADC_DAT_PORT
RET

DELAY_START: MOV R7, #225 // 500 US
DELAY_START_LOOP: DJNZ R7, DELAY_START_LOOP
RET

DELAY_DUTY_HIGH: MOV A, ADC_DAT // DUTY * (1900)
ACALL DELAY_DUTY
RET

DELAY_DUTY_LOW: MOV A, #0FFH // DUTY * (1900)
CLR C
SUBB A, ADC_DAT
ACALL DELAY_DUTY
RET

DELAY_DUTY: JZ DELAY_DUTY_DONE
MOV R7, A
DELAY_DUTY_LOOP: NOP
NOP
NOP
NOP
NOP
DJNZ R7, DELAY_DUTY_LOOP
DELAY_DUTY_DONE: RET

DELAY_END: MOV R7, #32 // 17600 US
DELAY_END_LOOP1: MOV R6, #250
DELAY_END_LOOP2: DJNZ R6, DELAY_END_LOOP2
DJNZ R7, DELAY_END_LOOP1
RET

END
