LCDINIT EQU 0E267H
LCDCMD EQU 0E295H
LCDDAT EQU 0E2B4H
LCDSTR EQU 0E39EH
HEX2ASCII EQU 03B0H

CHANNELS EQU P1
INPUT EQU P0

ORG 0000H

LCALL LCDINIT
MOV A, #06H // shift cursor right
LCALL LCDCMD

MOV A, #0C0H // line 2 column 1
LCALL LCDCMD
MOV DPTR, #TEXT
LCALL LCDSTR

UP1: MOV INPUT, #0FFH
MOV CHANNELS, #00H
MOV A, INPUT
ANL A, #0FH
CJNE A, #0FH, UP1

UP2: ACALL DBDELAY
MOV A, INPUT
ANL A, #0FH
CJNE A, #0FH, PRESS
SJMP UP2

PRESS: ACALL DBDELAY
MOV A, INPUT
ANL A, #0FH
CJNE A, #0FH, DETECT
SJMP UP2

DETECT: MOV P1, #11111110B
MOV A, INPUT
ANL A, #0FH
CJNE A, #0FH, ROW0
MOV P1, #11111101B
MOV A, INPUT
ANL A, #0FH
CJNE A, #0FH, ROW1
MOV P1, #11111011B
MOV A, INPUT
ANL A, #0FH
CJNE A, #0FH, ROW2
MOV P1, #11110111B
MOV A, INPUT
ANL A, #0FH
CJNE A, #0FH, ROW3
LJMP UP2

ROW0: MOV DPTR, #CODE0
SJMP FIND
ROW1: MOV DPTR, #CODE1
SJMP FIND
ROW2: MOV DPTR, #CODE2
SJMP FIND
ROW3: MOV DPTR, #CODE3

FIND: RRC A
JNC MATCH
INC DPTR
SJMP FIND

MATCH: CLR A
MOVC A, @A+DPTR
MOV 30H, A
MOV A, #0CEH // MOVE CURSOR
LCALL LCDCMD
MOV A, 30H // DISPLAY HEX
LCALL LCDDAT
LJMP UP1

DBDELAY: MOV R7, #024H // ~20 ms
D1: MOV R6, #0FFH
D2: DJNZ R6,D2
DJNZ R7, D1
RET

ORG 0300H

CODE0: DB '0', '1', '2', '3'
CODE1: DB '4', '5', '6', '7'
CODE2: DB '8', '9', 'A', 'B'
CODE3: DB 'C', 'D', 'E', 'F'

TEXT: DB 'KEY PRESSED = ', 0 // cursor next at col 14, #0CEH

END
