LCDINIT EQU 0E267H
LCDCMD EQU 0E295H
LCDDAT EQU 0E2B4H
LCDSTR EQU 0E39EH
HEX2ASCII EQU 03B0H

DAT EQU P1
EOC BIT P2.0
OE BIT P0.6
ADD_A BIT P0.0
ADD_B BIT P0.1
ADD_C BIT P0.2
ADD_D BIT P0.3
SC_ALE BIT P0.5

ORG 0000H

LCALL LCDINIT
MOV A, #06H // shift cursor right
LCALL LCDCMD
MOV A, #80H // 1st line 1st position
LCALL LCDCMD

SETB ADD_A
CLR ADD_B
SETB ADD_C
CLR ADD_D
CLR OE
SETB EOC
CLR SC_ALE

HERE: ACALL CONVERT
ACALL DISPLAY
SJMP HERE

CONVERT: SETB EOC
SETB SC_ALE
NOP
CLR SC_ALE
WAIT1: JB EOC, WAIT1
WAIT2: JNB EOC, WAIT2
MOV DAT, #0FFH
SETB OE
MOV A, DAT
CLR OE
RET

DISPLAY: MOV 30H, A
MOV A, #01H // reset LCD
LCALL LCDCMD
MOV A, #80H // 1st line 1st position
LCALL LCDCMD
MOV A, 30H
SWAP A // HIGHER NIBBLE
ANL A, #0FH
LCALL HEX2ASCII
LCALL LCDDAT
MOV A,30H
ANL A,#0FH // LOWER NIBBLE
LCALL HEX2ASCII
LCALL LCDDAT
MOV A,#'H' // 'H' AT END
LCALL LCDDAT
ACALL DELAY
RET

DELAY: MOV R7, #0FFH // ~142 ms
D1: MOV R6, #0FFH
D2: DJNZ R6,D2
DJNZ R7, D1
RET

END
